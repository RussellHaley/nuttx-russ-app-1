## Kconfig
```kconfig
#
# For a description of the syntax of this configuration file,
# see the file kconfig-language.txt in the NuttX tools repository.
#

config EXAMPLES_RUSSELLSAPP
	tristate "Russells first example"
	default n
	---help---
		Enable Russells first nuttx app

if EXAMPLES_RUSSELLSAPP

config EXAMPLES_RUSSELLSAPP_PROGNAME
	string "Program name"
	default "RussellsApp"
	---help---
		This is the name of the program that will be used when the NSH ELF
		program is installed.

config EXAMPLES_RUSSELLSAPP_PRIORITY
	int "RussellsApp task priority"
	default 100

config EXAMPLES_RUSSELLSAPP_STACKSIZE
	int "RussellsApp stack size"
	default DEFAULT_TASK_STACKSIZE

endif
```
